/**
 * @cliArgs --device "F2803x" --package "F2803x_64PAG" --part "F2803x_64PAG"
 * @versions {"tool":"1.20.0+3587"}
 */

/**
 * These are the peripherals and settings in this configuration
 */
const iECAN1             = scripting.addPeripheral("ECAN");
iECAN1.$name             = "CAN1";
iECAN1.$assign           = "ECANA";
iECAN1["CANRX@"].$assign = "GPIO30";
iECAN1["CANTX@"].$assign = "GPIO31";
const iGPIO1             = scripting.addPeripheral("GPIO");
iGPIO1["0"].$assign      = "GPIO22";
iGPIO1.$name             = "IsCANBaudSelect";
const iGPIO2             = scripting.addPeripheral("GPIO");
iGPIO2.$numPins          = 3;
iGPIO2["0"].$assign      = "GPIO24";
iGPIO2["1"].$assign      = "GPIO21";
iGPIO2["2"].$assign      = "GPIO20";
iGPIO2.$name             = "TruckSelect";
const iGPIO3             = scripting.addPeripheral("GPIO");
iGPIO3["0"].$assign      = "GPIO18";
iGPIO3.$name             = "IsEmergency";
const iGPIO4             = scripting.addPeripheral("GPIO");
iGPIO4["0"].$assign      = "GPIO17";
iGPIO4.$name             = "IsSetPlus";
const iGPIO5             = scripting.addPeripheral("GPIO");
iGPIO5["0"].$assign      = "GPIO8";
iGPIO5.$name             = "IsSetMinus";
const iGPIO6             = scripting.addPeripheral("GPIO");
iGPIO6["0"].$assign      = "GPIO16";
iGPIO6.$name             = "IsMotorStart";
const iGPIO7             = scripting.addPeripheral("GPIO");
iGPIO7["0"].$assign      = "GPIO12";
iGPIO7.$name             = "IsMotorStop";
const iGPIO8             = scripting.addPeripheral("GPIO");
iGPIO8.$numPins          = 2;
iGPIO8["0"].$assign      = "GPIO7";
iGPIO8["1"].$assign      = "GPIO6";
iGPIO8.$name             = "PTOMode";
const iGPIO9             = scripting.addPeripheral("GPIO");
iGPIO9.$numPins          = 3;
iGPIO9["0"].$assign      = "GPIO19";
iGPIO9["1"].$assign      = "GPIO11";
iGPIO9["2"].$assign      = "GPIO4";
iGPIO9.$name             = "RPMMode";
const iGPIO10            = scripting.addPeripheral("GPIO");
iGPIO10.$numPins         = 3;
iGPIO10["0"].$assign     = "GPIO10";
iGPIO10["1"].$assign     = "GPIO3";
iGPIO10["2"].$assign     = "GPIO2";
iGPIO10.$name            = "SpeedMode";
const iGPIO11            = scripting.addPeripheral("GPIO");
iGPIO11["0"].$assign     = "GPIO1";
iGPIO11.$name            = "IsOpt1";
const iGPIO12            = scripting.addPeripheral("GPIO");
iGPIO12["0"].$assign     = "GPIO0";
iGPIO12.$name            = "IsOpt2";
const iGPIO13            = scripting.addPeripheral("GPIO");
iGPIO13["0"].$assign     = "GPIO23";
iGPIO13.$name            = "IsOpt3";
const iI2C1              = scripting.addPeripheral("I2C");
iI2C1.$name              = "I2C1";
iI2C1.$assign            = "I2CA";
iI2C1["SDA@"].$assign    = "GPIO32";
iI2C1["SCL@"].$assign    = "GPIO33";
const iJTAG1             = scripting.addPeripheral("JTAG");
iJTAG1.$name             = "JTAG";
iJTAG1.$assign           = "JTAG";
iJTAG1.TDO.$assign       = "GPIO37";
iJTAG1.TDI.$assign       = "GPIO35";
iJTAG1.TMS.$assign       = "GPIO36";
iJTAG1.TCK.$assign       = "GPIO38";
const iSCI1              = scripting.addPeripheral("SCI");
iSCI1.$name              = "UART1";
iSCI1.$assign            = "SCIA";
iSCI1["SCIRXD@"].$assign = "GPIO28";
iSCI1["SCITXD@"].$assign = "GPIO29";
