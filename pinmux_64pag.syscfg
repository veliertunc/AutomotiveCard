/**
 * These arguments were used when this file was generated. They will be automatically applied on subsequent loads
 * via the GUI or CLI. Run CLI with '--help' for additional information on how to override these arguments.
 * @cliArgs --device "F2803x" --package "F2803x_64PAG" --part "F2803x_64PAG"
 * @versions {"tool":"1.20.0+3587"}
 */

/**
 * These are the peripherals and settings in this configuration
 */
const iECAN1             = scripting.addPeripheral("ECAN");
iECAN1.$name             = "CAN1";
iECAN1["CANRX@"].$assign = "GPIO30";
iECAN1["CANTX@"].$assign = "GPIO31";
const iGPIO1             = scripting.addPeripheral("GPIO");
iGPIO1.$numPins          = 2;
iGPIO1["0"].$assign      = "GPIO10";
iGPIO1["1"].$assign      = "GPIO11";
iGPIO1.$name             = "CANBaudSelect";
const iI2C1              = scripting.addPeripheral("I2C");
iI2C1.$name              = "I2C1";
iI2C1["SDA@"].$assign    = "GPIO32";
iI2C1["SCL@"].$assign    = "GPIO33";
const iJTAG1             = scripting.addPeripheral("JTAG");
iJTAG1.$name             = "MyJTAG1";
const iSCI1              = scripting.addPeripheral("SCI");
iSCI1.$name              = "UART1";
iSCI1["SCIRXD@"].$assign = "GPIO28";
iSCI1["SCITXD@"].$assign = "GPIO29";

/**
 * Pinmux solution for unlocked pins/peripherals. This ensures that minor changes to the automatic solver in a future
 * version of the tool will not impact the pinmux you originally saw.  These lines can be completely deleted in order to
 * re-solve from scratch.
 */
iECAN1.$suggestSolution     = "ECANA";
iI2C1.$suggestSolution      = "I2CA";
iJTAG1.$suggestSolution     = "JTAG";
iJTAG1.TDO.$suggestSolution = "GPIO37";
iJTAG1.TDI.$suggestSolution = "GPIO35";
iJTAG1.TMS.$suggestSolution = "GPIO36";
iJTAG1.TCK.$suggestSolution = "GPIO38";
iSCI1.$suggestSolution      = "SCIA";
